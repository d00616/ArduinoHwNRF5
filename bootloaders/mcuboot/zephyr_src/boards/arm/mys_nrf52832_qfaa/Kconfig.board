## bootloaders/mcuboot/zephyr_src/boards/arm/mys_nrf52832_qfaa/Kconfig.board
```kconfig
# Kconfig - nRF52 BLENANO 2 board configuration
#
# Copyright (c) 2016 Linaro Limited.
#
# SPDX-License-Identifier: Apache-2.0


config BOARD_NRF52832_QFAA
	bool "nRF52 NRF52832_QFAA"
	depends on SOC_NRF52832_QFAA
```

## bootloaders/mcuboot/zephyr_src/boards/arm/mys_nrf52840_qfaa/Kconfig.board
```kconfig
# Kconfig - nRF52 BLENANO 2 board configuration
#
# Copyright (c) 2016 Linaro Limited.
#
# SPDX-License-Identifier: Apache-2.0


config BOARD_NRF52840_QFAA
	bool "nRF52 NRF52840_QFAA"
	depends on SOC_NRF52840_QFAA
```

## bootloaders/mcuboot/zephyr_src/boards/arm/mys_nrf52840_qfaa/mys_nrf52840_qfaa_defconfig
```kconfig
CONFIG_ARM=y
CONFIG_SOC_FAMILY_NRF5=y
CONFIG_SOC_SERIES_NRF52X=y
CONFIG_SOC_NRF52840_QFAA=y

# Enable MPU
CONFIG_ARM_MPU_NRF52X=y

# enable uart driver
CONFIG_SERIAL=n
CONFIG_UART_NRF5=n

# enable console
CONFIG_CONSOLE=n
CONFIG_UART_CONSOLE=n

# additional board options
CONFIG_GPIO_AS_PINRESET=n

# bluetooth
CONFIG_BT=n
CONFIG_BT_CTLR=n
```
